## lib/rtl87x2j_platform_lib_sample/sample.yaml
```yaml
sample:
  name: RTL87X2J External Platform Library
tests:
  sample.app_dev.rtl87x2j_platform_lib:
    platform_allow:
      - rtl87x2j_evb/rtl8762jth
    integration_platforms:
      - rtl87x2j_evb/rtl8762jth
    tags:
      - external
      - realtek
    harness: console
    harness_config:
      type: one_line
      regex:
        - "RTL87X2J external platform library sample running"
```

## west.yml
```yaml
manifest:
  self:
    path: realtek-zephyr-project
    west-commands: tool/west-commands.yml

  remotes:
    - name: rtkconnectivity
      url-base: https://github.com/rtkconnectivity
    - name: zephyr
      url-base: https://github.com/zephyrproject-rtos

  defaults:
    remote: rtkconnectivity

  projects:
    - name: zephyr
      remote: rtkconnectivity
      revision: pull/314/head
      import:
        name-allowlist:
          - cmsis
          - cmsis_6
          - hal_realtek
          - mbedtls
          - tf-psa-crypto
          - segger
          - cmsis-dsp
          - cmsis-nn
          - mldsa-native
          - littlefs
          - fatfs
          - mcuboot
          - zcbor
          - mipi-sys-t

    #
    # Realtek based overrides of hal_realtek, mcuboot and tf-psa-crypto modules
    #
    - name: hal_realtek
      remote: rtkconnectivity
      revision: pull/21/head
      path: modules/hal/realtek
      groups:
        - hal

    - name: mcuboot
      remote: rtkconnectivity
      repo-path: zephyr-mcuboot
      revision: v4.4-bee
      path: bootloader/mcuboot
      groups:
        - bootloader

    - name: tf-psa-crypto
      remote: rtkconnectivity
      repo-path: zephyr-tf-psa-crypto
      revision: v4.4.0-bee-psa-accelerators
      path: modules/crypto/tf-psa-crypto
      groups:
        - crypto
```
